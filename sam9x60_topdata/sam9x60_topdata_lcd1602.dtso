// SPDX-License-Identifier: (GPL-2.0+ OR MIT)
/*
 * Device Tree file for SAM9X60.
 *
 * Copyright (C) 2024 Topdata.
 *
 */
/dts-v1/;
/plugin/;

#include "dt-bindings/pinctrl/at91.h"
#include "dt-bindings/input/input.h"
#include "dt-bindings/gpio/gpio.h"

&{/} {
	model = "Microchip SAM9X60 LCD1602 + Keypad";

	matrix_keypad: matrix-keypad {
		compatible = "gpio-matrix-keypad";
		debounce-delay-ms = <10>;
		col-scan-delay-us = <10>;
		
		row-gpios = <&pioB 23 GPIO_ACTIVE_HIGH
					 &pioA 26 GPIO_ACTIVE_HIGH
					 &pioA 23 GPIO_ACTIVE_HIGH
					 &pioB 19 GPIO_ACTIVE_HIGH>;

		col-gpios = <&pioA 29 GPIO_ACTIVE_LOW
					 &pioD 20 GPIO_ACTIVE_LOW
					 &pioA 24 GPIO_ACTIVE_LOW
					 &pioD 16 GPIO_ACTIVE_LOW>;

		linux,keymap = <MATRIX_KEY(0, 0, KEY_1)
						MATRIX_KEY(0, 1, KEY_2)
						MATRIX_KEY(0, 2, KEY_3)
						MATRIX_KEY(0, 3, KEY_F)
						MATRIX_KEY(1, 0, KEY_4)
						MATRIX_KEY(1, 1, KEY_5)
						MATRIX_KEY(1, 2, KEY_6)
						MATRIX_KEY(1, 3, KEY_UP)
						MATRIX_KEY(2, 0, KEY_7)
						MATRIX_KEY(2, 1, KEY_8)
						MATRIX_KEY(2, 2, KEY_9)
						MATRIX_KEY(2, 3, KEY_DOWN)
						MATRIX_KEY(3, 0, KEY_ESC)
						MATRIX_KEY(3, 1, KEY_0)
						MATRIX_KEY(3, 2, KEY_OK)
						MATRIX_KEY(3, 3, KEY_MENU)>;
	};

	// display-controller {
    //     compatible = "hit,hd44780";
    //     data-gpios = <&pioA 0 GPIO_ACTIVE_HIGH>,
    //                  <&pioA 1 GPIO_ACTIVE_HIGH>,
    //                  <&pioA 2 GPIO_ACTIVE_HIGH>,
    //                  <&pioA 3 GPIO_ACTIVE_HIGH>,
	// 				 <&pioA 4 GPIO_ACTIVE_HIGH>,
    //                  <&pioA 5 GPIO_ACTIVE_HIGH>,
    //                  <&pioA 6 GPIO_ACTIVE_HIGH>,
    //                  <&pioA 7 GPIO_ACTIVE_HIGH>;
    //     enable-gpios = <&pioA 8 GPIO_ACTIVE_HIGH>;
    //     rs-gpios = <&pioA 9 GPIO_ACTIVE_HIGH>;
	// 	   backlight-gpios = <&pioA 11 GPIO_ACTIVE_HIGH>;	 
    //     display-height-chars = <2>;
    //     display-width-chars = <16>;
    // };
};
